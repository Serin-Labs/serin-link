## main/Kconfig.projbuild
```kconfig
menu "Serin board"

choice SERIN_BOARD
    prompt "Target board"
    default SERIN_BOARD_VIEWE_15
    help
        Select the hardware. Pair each board with its sdkconfig overlay, e.g.
        -DSDKCONFIG_DEFAULTS="sdkconfig.defaults;sdkconfig.defaults.viewe".

config SERIN_BOARD_VIEWE_15
    bool "VIEWE 1.5\" Touch-Knob (SH8601 466x466 QSPI AMOLED)"
    help
        VIEWE UEDX46460015-MD50ET. ESP32-S3R8 + PSRAM, CST820 touch, rotary
        knob + BOOT button. Overlay: sdkconfig.defaults.viewe.

config SERIN_BOARD_VIEWE_21
    bool "VIEWE 2.1\" Touch-Knob (ST7701S 480x480 RGB)"
    help
        VIEWE UEDX48480021-MD80ET. ESP32-S3R8 (16MB flash, 8MB OPI PSRAM),
        CST816S touch, rotary encoder + BOOT-button knob press, no I/O
        expander. The UI lays out at 480x480 here, not the 1.5"'s 466.
        Overlay: sdkconfig.defaults.viewe21.

endchoice

choice SERIN_PM_MIN_FREQ
    prompt "Idle CPU frequency"
    depends on PM_ENABLE
    default SERIN_PM_MIN_80
    help
        Keep the configured maximum CPU speed for runnable work, and lower it
        while idle. Automatic light sleep remains disabled. Peripheral PM
        locks can keep the CPU above this minimum (notably PCNT on VIEWE 2.1).

config SERIN_PM_MIN_80
    bool "80 MHz"

config SERIN_PM_MIN_40
    bool "40 MHz (bench comparison)"

endchoice

config SERIN_PM_MIN_FREQ_MHZ
    int
    default 40 if SERIN_PM_MIN_40
    default 80

config SERIN_LVGL_MONOTONIC_TICK
    bool "Use elapsed time instead of the periodic LVGL tick"
    default y
    help
        Stop the port's 5 ms tick timer and read esp_timer time through LVGL's
        tick callback. LVGL timers, input events, and its watchdog remain live.
        Disable only for a baseline comparison. Do not call lvgl_port_resume()
        after display_runtime_start(): the application owns tick scheduling.

config SERIN_INPUT_POWER_SAVE
    bool "Stop knob/button sampling while idle"
    depends on SERIN_BOARD_VIEWE_15
    default y
    select GPIO_BUTTON_SUPPORT_POWER_SAVE
    help
        Use the pinned drivers' GPIO interrupts to restart sampling on input.
        This does not enable automatic light sleep or change gesture timing.

config SERIN_LCD_BLOCKING_FLUSH
    bool "Block while waiting for QSPI display DMA"
    depends on SERIN_BOARD_VIEWE_15
    default y
    help
        Wait for a completion semaphore instead of spinning on LVGL's flushing
        flag. Drawing can still overlap DMA using the second buffer.

config SERIN_LCD_BUFFER_ROWS
    int "QSPI draw-buffer rows (per buffer)"
    depends on SERIN_BOARD_VIEWE_15
    default 60
    range 2 466
    help
        Must be even: the panel's invalidated areas are rounded to two pixels.
        60 rows use 109.22 KiB for the pair. 30 rows use 54.61 KiB but may add
        transfer overhead. Compare response time and DMA heap before changing.

# The public symbol and source filenames predate the production sensor choice.
# Keep them stable so existing sdkconfig overlays continue to work; the fitted
# carrier sensor is an SHT41.
config SERIN_SHT40
    bool "SHT41 temperature/humidity sensor (USB carrier PCB)"
    default y
    help
        Read the Sensirion SHT41 on the USB carrier PCB and offer the dial to
        the controller as a room-temperature source. Presence is probed at
        boot -- a dial without the carrier behaves exactly as before.
        Compiled out entirely when off.

        On for every board in the SERIN_BOARD choice: both carriers fit the
        sensor. The pins are NOT shared between them, so a board enabling this
        must also pin SERIN_SHT40_SDA_GPIO/SCL_GPIO -- read their help first.

config SERIN_SHT40_SDA_GPIO
    int "SHT41 I2C SDA GPIO"
    depends on SERIN_SHT40
    default -1 if SERIN_BOARD_VIEWE_21
    default 39
    help
        VIEWE 1.5": carrier CN3 pin 6 -> VIEWE flex pin 5. NOT the CST820 touch
        bus. GPIO39/40 are the S3's MTCK/MTDO external-JTAG pins; claiming them
        costs external JTAG only (USB Serial/JTAG on 19/20 is untouched).

        VIEWE 2.1": UNTRACED, hence -1. The 1.5" pair must NOT be carried over
        -- GPIO39 and GPIO40 are both RGB data lines on the 2.1"
        (RGB_DATA_PINS, main/bsp_viewe21.c), so that pair would put an I2C
        master on two pins the panel is actively driving. -1 fails
        i2c_new_master_bus, which sensor_sht40.c already handles: it logs
        "bring-up failed -- sensor disabled" and the dial runs as if no carrier
        were fitted. Trace the 2.1" carrier and pin the real pair here before
        expecting a reading. The free GPIOs on that board are few, and the
        touch bus (I2C_NUM_0, SCL15/SDA16) is not one of them -- this driver
        opens its own I2C_NUM_1 and cannot share a pin with another port.

config SERIN_SHT40_SCL_GPIO
    int "SHT41 I2C SCL GPIO"
    depends on SERIN_SHT40
    default -1 if SERIN_BOARD_VIEWE_21
    default 40
    help
        VIEWE 1.5": carrier CN3 pin 7 -> VIEWE flex pin 4.

        VIEWE 2.1": UNTRACED, hence -1. See SERIN_SHT40_SDA_GPIO.

config SERIN_SHT40_RH_GAIN_PPT
    int "SHT41 self-heating humidity gain (parts per thousand)"
    depends on SERIN_SHT40
    default 1000
    range 500 2000
    help
        Every humidity reading is MULTIPLIED by this / 1000 before it leaves the
        dial. 1000 means no correction.

        A gain, not an offset, because this is not a humidity error: it is
        SERIN_SHT40_OFFSET_CC showing up in the humidity channel. A sensor
        sitting dT above ambient reads relative humidity depressed by
        Psat(T)/Psat(T+dT), which is proportional to the reading -- so a fixed
        %RH offset fitted at one humidity is visibly wrong at another.

        Measure it as a RATIO against a reference, not a difference. The two
        differ in stability by about 4x, which is how you can tell the
        multiplicative model is the right one.

        It is only right for one dT, so re-fit it whenever
        SERIN_SHT40_OFFSET_CC changes:
        gain = exp(4283.78 * dT / ((243.12 + T) * (243.12 + T + dT))),
        with T the ambient temperature in C (Sensirion's Magnus constants).
        At T = 22: dT 0.90 -> 1056, 1.53 -> 1097, 2.72 -> 1178.

config SERIN_SHT40_OFFSET_CC
    int "SHT41 self-heating offset (centi-degrees C)"
    depends on SERIN_SHT40
    default 0
    range -2000 2000
    help
        Subtracted from every reading before it leaves the dial. The sensor
        sits behind an AMOLED next to a Wi-Fi-up S3 and reads HIGH -- typically
        several degrees in a sealed enclosure. This is the Idle screen = GLANCE
        value: measure it with the panel lit at idle, which is what Glance
        leaves it doing. Idle screen = Off is derived from it via
        SERIN_SHT40_IDLE_OFF_DELTA_CC.

        Default 0 until measured on an assembled unit against a reference; the
        NVS value set by the `sensor-offset` console command overrides this.

config SERIN_SHT40_IDLE_OFF_DELTA_CC
    int "SHT41 offset reduction when Idle screen = Off (centi-degrees C)"
    depends on SERIN_SHT40
    default 0
    range 0 2000
    help
        Subtracted from SERIN_SHT40_OFFSET_CC while Advanced -> Idle screen is
        set to Off. That pref sleeps the panel after 120 s instead of showing
        the lit glance face, so the sensor behind it settles cooler and LESS
        self-heating must be corrected away.

        Not per-device: this is a property of the panel's power draw, not of
        the individual unit, so there is no NVS override -- only the absolute
        level needs per-unit calibration. Default 0 makes both modes identical,
        i.e. exactly the behaviour before this existed; the board overlay pins
        the measured value.

config SERIN_PERF_STATS
    bool "Perf instrumentation (render/transfer timing, heap, interval CPU share)"
    default n
    help
        Build the perf_stats harness: LVGL render, flush-call, flush-wait, and
        QSPI-completion timing; heap headroom; CPU shares over each interval.
        Use perf-reset/perf-dump for explicit measurement windows,
        perf-glide/perf-nav for scripted workloads, and perf-pm for PM locks.
        There is no periodic reporting task after console registration.
        Enable via the sdkconfig.perf overlay, e.g.
        -DSDKCONFIG_DEFAULTS="sdkconfig.defaults;sdkconfig.defaults.viewe;sdkconfig.perf".
        Do not use LV_USE_PERF_MONITOR instead — it counts refr ticks, not
        redraws, on this stack.

config SERIN_LINK_OTA_MANIFEST_URL
    string "Link firmware manifest URL"
    default "https://raw.githubusercontent.com/Serin-Labs/serin-cn105/main/firmware/link/ota/stable/manifest.json"
    help
        Fetched over HTTPS when the user runs the update check from
        Settings -> System. Each build's `path` in the manifest is resolved
        relative to this URL's directory. Signed plaintext images are served
        from the public serin-cn105 distribution repo under link/ota/stable/.
        Legacy encrypted feeds at link/manifest.json are a different format
        and must not be used by this firmware.

        This is only the built-in default. The `ota-url` console command
        overrides it per channel in NVS, so a dial can be pointed at a
        self-hosted manifest without a rebuild -- which is also what you want
        if you sign with your own key, since an image signed by anyone else
        fails the signature check after it downloads. For LAN bench tests use
        the sdkconfig.otadev overlay (plain http:// needs
        ESP_HTTPS_OTA_ALLOW_HTTP).

config SERIN_LINK_OTA_MANIFEST_BETA_URL
    string "Link beta-channel manifest URL (empty = no beta channel)"
    default "https://raw.githubusercontent.com/Serin-Labs/serin-cn105/main/firmware/link/ota/beta/manifest.json"
    help
        Same signed plaintext format as stable, under link/ota/beta/ in the
        public distribution repo. Stage with tools/publish_fw.py --channel beta
        --distribution <serin-cn105 checkout>. Stable and beta have separate
        directories. Used instead of the stable URL
        while the NVS pref `ota_beta` is set (console: `ota-channel beta`),
        mirroring the controller's opt-in beta toggle. A pre-release build
        (version maj.min.patch-word.N) defaults the pref to set, so a dial
        installed from a beta image is not offered the older stable release;
        `ota-channel stable` stores an explicit opt-out. Leave empty to compile
        the channel out: `ota-channel beta` is then refused.

config SERIN_THERMAL_CAL
    bool "Thermal calibration rig (calibration builds only)"
    depends on SERIN_SHT40 && SERIN_BOARD_VIEWE_15
    default n
    help
        Thermal calibration build setting.

config SERIN_CAL_DISPLAY_TEST
    bool "Display-control verification cycle (instead of the sweep)"
    depends on SERIN_THERMAL_CAL
    default n
    help
        Thermal calibration build setting.

config SERIN_CAL_PROFILE_SHORT
    bool "Short profile: 4 regimes (~2.7 h) instead of 9 (~6.5 h)"
    depends on SERIN_THERMAL_CAL
    default n
    help
        Thermal calibration build setting.

config SERIN_CAL_DWELL_MIN
    int "Regime dwell (minutes)"
    depends on SERIN_THERMAL_CAL
    default 20
    range 2 120
    help
        Thermal calibration build setting.

config SERIN_CAL_BASELINE_MIN
    int "Baseline dwell between regimes (minutes)"
    depends on SERIN_THERMAL_CAL
    default 20
    range 2 120
    help
        Thermal calibration build setting.

config SERIN_CAL_SETTLE_MIN
    int "Initial settle before the first step (minutes)"
    depends on SERIN_THERMAL_CAL
    default 30
    range 0 120
    help
        Thermal calibration build setting.

config SERIN_CAL_RING_RECS
    int "PSRAM ring depth (records of 32 bytes)"
    depends on SERIN_THERMAL_CAL
    default 4096
    range 256 32768
    help
        Thermal calibration build setting.

config SERIN_CAL_WIFI_SSID
    string "Wi-Fi SSID for the radio regimes"
    depends on SERIN_THERMAL_CAL
    default ""
    help
        Thermal calibration build setting.

config SERIN_CAL_WIFI_PSK
    string "Wi-Fi password for the radio regimes"
    depends on SERIN_THERMAL_CAL
    default ""
    help
        Thermal calibration build setting.

config SERIN_CAL_LOAD_URL
    string "URL fetched in a loop for the sustained-radio regime"
    depends on SERIN_THERMAL_CAL
    default "https://raw.githubusercontent.com/Serin-Labs/serin-cn105/main/firmware/link/ota/stable/manifest.json"
    help
        Thermal calibration build setting.

endmenu
```
